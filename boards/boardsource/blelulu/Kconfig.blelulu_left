## boards/boardsource/blelulu/Kconfig.blelulu_left
```kconfig
#
# Copyright (c) 2026 jack@pngu.org
# SPDX-License-Identifier: MIT
#

config BOARD_BLELULU_LEFT
    select SOC_NRF52840_QIAA
    select ZMK_BOARD_COMPAT
```

## boards/boardsource/blelulu/Kconfig.defconfig
```kconfig
#
# Copyright (c) 2026 jack@pngu.org
# SPDX-License-Identifier: MIT
#

if BOARD_BLELULU_LEFT

config ZMK_KEYBOARD_NAME
    default "BLE Lulu"

config ZMK_SPLIT_ROLE_CENTRAL
    default y

endif # BOARD_BLELULU_LEFT

if BOARD_BLELULU_LEFT || BOARD_BLELULU_RIGHT

config BOARD
    default "blelulu"

config ZMK_SPLIT
    default y

config BT_CTLR
    default BT

if USB

config USB_NRFX
    default y

config USB_DEVICE_STACK
    default y

endif # USB

if ZMK_DISPLAY

config SPI
    default y

config ZMK_DISPLAY_BLANK_ON_IDLE
    default n

endif # ZMK_DISPLAY

endif # BOARD_BLELULU_LEFT || BOARD_BLELULU_RIGHT
```

## boards/boardsource/blelulu/board.yml
```yaml
boards:
  - name: blelulu_left
    vendor: boardsource
    socs:
      - name: nrf52840
    revision:
      format: major.minor.patch
      default: 1.0.0
      exact: false
      revisions:
        - name: 1.0.0
  - name: blelulu_right
    vendor: boardsource
    socs:
      - name: nrf52840
    revision:
      format: major.minor.patch
      default: 1.0.0
      exact: false
      revisions:
        - name: 1.0.0
```

## config/west.yml
```yaml
manifest:
  remotes:
    - name: zmkfirmware
      url-base: https://github.com/zmkfirmware
    - name: invrtd
      url-base: https://github.com/invrtd
  projects:
    - name: zmk
      remote: invrtd
      revision: nice!view-180
      import: app/west.yml
  self:
    path: config
```
